// SPDX-License-Identifier: GPL-2.0-only

/dts-v1/;

#include <skeleton.dtsi>

/ {
	model = "Mobvoi TicWatch Pro";
	qcom,msm-id = <265 0>, <301 0>;
	qcom,board-id= <8 0x105>;
	mobvoi-catfish {
		compatible = "mobvoi,catfish", "qcom,msm8909", "lk2nd,device";
		lk2nd,match-panel;
		panel {
			compatible = "mobvoi,catfish-panel";
			qcom,mdss_dsi_rm67162_wqvga_cmd {
				compatible = "mobvoi,rm67162";
			};
		};
	};
};
